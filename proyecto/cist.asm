; PIC16F877A Configuration Bit Settings

; Assembly source line config statements

#include "p16f877a.inc"

; CONFIG
; __config 0xFF32
 __CONFIG _FOSC_HS & _WDTE_OFF & _PWRTE_ON & _BOREN_OFF & _LVP_OFF & _CPD_OFF & _WRT_OFF & _CP_OFF

    CBLOCK 0xA0
	SMS;		VARIABLE 0
	SMS_ERR_STATUS	; VARIABLE 1
	SMS_FERR	; VARIABLE 2
	SMS_OERR	; VARIABLE 3
	NIVEL_TINACO	;
    ENDC
CBLOCK 0xA7
 CUENTA
 CUENTA_2
 
ENDC
 
    ORG	0X00
    BCF	STATUS,RP1;				CAMBIO DE BANCO
    BCF	STATUS,RP0;BANCO 0
    GOTO	INICIO
ORG 0X04
    BCF	STATUS,RP1;				CAMBIO DE BANCO
    BCF	STATUS,RP0;BANCO 0
    BTFSC PIR1, RCIF;	   SI HAY MENSAJE VERIFICO QUE PASO PRIMERO
    CALL RECIBIR;	    SI NO HAY MENSAJE PREGUNTO SI ESTA ACTIVADO MODO MANUAL 
    RETFIE
    
RECIBIR:
    CLRF W; LIMPIO PARA SABER EL TIPO DE ERROR AL SALIR DEL CICLO, SI W SALE CON 0 DE AQUI, TODO OK
    CLRF SMS_ERR_STATUS;    LIMPIO EL ERROR QUE HUBO POR SI OCURRE OTRO, LLEVO CONTROL
    BTFSS PIR1, RCIF;	    ESPERO A QUE SE CARGUE EL RCREG, SI MANEJO INT OMITO ESTA PREGUNT A MENOS QUE HAYA OTRA INTERRUPCION ENTONCES TENGO QUE HACER POLLIN PARA SABER CUAL FLAG SE LEVANTO
    GOTO RECIBIR;	    POR SI CAMBIO EL MENSAJE DESDE QUE ENTRE AQUI, ESPERO A TENER EL MENSAJE MAS NUEVO
    CALL REVISAR;	    MENSAJE EN RCREG, CHEQUEO ERRORES EN LA TRANSMISION
    MOVF RCSTA, W;	    LEO EL ESTATUS DE LOS ERRORES ANTES QUE SE BORREN
    MOVWF SMS_ERR_STATUS;   LOS GUARDO EN UN REGISTRO TEMPORAL
    MOVF RCREG, W;	    LEO EL MENSAJE RECIBIDO SIN ERRORES 
    MOVWF SMS;		    Y LO PASO A UN REGISTRO TEMPORAL
    CALL ON_OFF
    RETURN
REVISAR:
    BTFSC RCSTA, FERR;	    VERIFICO SI HUBO ERROR DE FERR, 
    GOTO ERR_1;		    LEYO MAL EL BIT DE PARADA, LO LEYO COMO 0
    BTFSC RCSTA, OERR;	    VERIFICO SI HUBO ERROR DE OERR
    GOTO ERR_2;		    LEYO MAL UN BIT, NO CARGO COMPLETO 
    RETURN; SIN ERRORES PUEDO LEER
    
ERR_1:
    MOVF RCSTA, W
    MOVWF SMS_ERR_STATUS;   LEO LOS ERRORES Y LOS GUARDO
    MOVF RCREG, W;	    LIMPIO EL BUFFER PARA LEER UN NUEVO MENSAJE LIMPIA RCREG, RCIF = 0, LIMPIA EL FERR, LEE RX9D
    MOVWF SMS_FERR;	    MENSAJE MAS ABAJO
    GOTO RECIBIR;	    RECIBE OTRA VEZ QUE VINO EL MENSAJE MALO
    ;/* GUARDO EL MENSAJE CON EL ERROR PARA COMPARAR
    ;/*O LLEVAR REGISTRO DE SI HUBO ERRORES EN LA RECEPCION ;PODRIA RETORNAR NORMAL, SI ACTIVO LA INTERRUPCION PORQUE AL LEER EL RCREG, 
    ;/* ESTOY LIMPIANDO LA BANDERA Y VOLVERIA A ESPERAR QUE SE CARGUE EL MENSAJE PARA RETORNAR */
    
ERR_2:
    MOVF RCSTA, W
    MOVWF SMS_ERR_STATUS;   LEO LOS ERRORES Y LOS GUARDO
    MOVF RCREG, W;	    LEO RX9D, LIMPIO EL RCREG Y EL FERR PARA RECIBIR UN NUEVO MENSAJE
    
; CREO QUE LEE EL MENSAJE ANTERIOR O LEE CERO, SI LO CARGA MAL LO QUE ESTA RSR SE BORRA
;PERO BLOQUEA LA RECEPCION!!! HAY QUE ESTAR PILA
    MOVWF SMS_OERR;	    GUARDO EL MENSAJE MALO PARA COMPARAR CON LOS BUENOS
    BCF RCSTA,CREN;	    LIMPIO EL ERROR
    BSF RCSTA,CREN;	    LIMPIO EL ERROR
    GOTO RECIBIR;	    VUELVE A RECIBIR QUE EL MENSAJE VINO MALO

ON_OFF:
    MOVLW 0X01; 'ON'
    ANDWF SMS, W
    BTFSS W,0
    GOTO OFF
    CALL ON
    RETURN
    
OFF:
		BCF		CCP1CON,3		; PWM MODE DISABLED
		BCF		CCP1CON,2
		BCF		CCP1CON,1
		BCF		CCP1CON,0						
		RETURN
ON:
								;SE SUPONE QUE ACA SOLO VENGO POR ORDEN DEL TINACO PERO DEBEMOS CHEQUEAR EL NIVEL PRIMERO
		BCF	STATUS,Z
		BCF	STATUS,C;	  	NO SE SI ESTAS BANDERAS TAMBIEN HAY QUE LIMPIARLAS PERO PORSIA
		MOVF	ADRESH,W;      	NIVEL DEL TANQUE
		SUBLW	D'51';		   	TESTEAR CON 1 VOLTIO
		BTFSC 	STATUS,Z
		GOTO	OFF;	1 VOLTIO DE NIVEL
		BTFSS	STATUS,C
		GOTO	PLAY;		   	NIVEL > 1 VOLTIO
		CALL	OFF;    NIVEL <1 VOLTIO
RETURN;REVISAR QUE TE DEVUELVES AQUI Y QUE NO HAY REDUNDANCIA

PLAY:
		BSF		CCP1CON,3		; PWM MODE ON
		BSF		CCP1CON,2
		BSF		CCP1CON,1
		BSF		CCP1CON,0			
RETURN
    
    ;MANUAL:
    ;AQUI DEBERIA REVISAR EL NIVEL DEL AGUA EN EL TINACO, PERO TENGO QUE HACERLO AQUI MISMO
    ;SINO ME QUEDO EN LA INTERRUPCION PARA SIEMPRE, SERIA BUENO TENER LA INFO DEL NIVEL A LA MANO
    ;TIPO PARA NO SALIR DE ESTA RUTINA Y SOLO TRANSMITIR
    ; AQUI DEBERIA DESBLOQUEAR LA BOMBA PARA QUE LA PRENDAN AFUERA
    ;ESCENARIOS:
    ;SI ESTA LLENO EL TINACO TENGO QUE APAGAR PARA QUE NO SE BOTE EL AGUA
    ;VE
    
;PREGUNTO     
    
    ;SI NO HAY AGUA EN LA CISTERNA TENGO TRANSMITIR

    ;ACA VA LO DEMAS
    
    ; SI SE LLENO EL TINACO CUANDO VUELVA A ENTRAR AL CICLO CUMPLE LA CONDICION DE SALIDA Y 
    ;SALE PERO MIENTRAS ESTE EL SWITCHE ENCENDIDO, ESTO SE REPITE HASTA QUE PASEMOS EL SWITCHE
    ;CONDICION DE SALIDA AQUI ABAJO
    ;MOVLW 0X10; 'MANUAL'
    ;ANDWF SMS, W
    ;BTFSC W,4
    ;RETFIE; MANUAL ON, SALGO DE RUTINA SIN LIMPIAR LA BANDERA, PERO PRIMERO RECIBO EL MENSAJE PARA SALIR
    ;BCF INTCON, INTF; LIMPIO LA BANDERA PARA SALIR DEL MODO MANUAL, OFF
    ;RETURN

INICIO:						
;/*******************************************************************************
;**********************  CISTERNA Y PWM ***********************************************/
;   PR2 = 155
;   CCPR1L = 00111110
;   CCPCON1 = 10
;   CCP1CON -> SALIDA RC2
;   PRESCALER = 4
;   TMR2 ON
;   CCP1 = PWM OPERACION
;	PERIODO PWM 100MICROSEGUNDOS
		CLRF PORTA
		CLRF PORTB
		CLRF PORTC
		CLRF PORTD
		CLRF PORTE; LIMPIO LOS PUERTOS
		BCF STATUS,RP1;
		BSF STATUS,RP0;		CAMBIO DE BANCO
								;BANCO 1
		BCF TRISB, 2
;CISTERNA
		MOVLW	d'47'			; 00101111B CONFIG PUERTO A CON 5 ENTRADAS Y UNA SALIDA(RA4)
		MOVWF	TRISA			;RA0:RA3,RA5 ->	ENTRADAS
		BCF TRISA,6
								;CONFIGURACION DE LOS PINES DEL CONVERTIDOR A/D, AFECTA 8 PINES
								;RA0-RA5 Y RE0-RE2
		BCF		ADCON1,PCFG3	;PCFG3:PCFG0 (ADCON1<3:0>)	
		BCF		ADCON1,PCFG2
		BSF		ADCON1,PCFG1
		BCF		ADCON1,PCFG0	;0010 -> 5 INPUTS A Y 3 I/O DIGITALES
;	/*
	    ;RA0 = AN0 -> INPUT NO INV COMPARADOR A 1
	    ;RA1 = AN1 -> INPUT NO INV COMPARADOR A 2
	    ;RA2 = AN2 -> SOBREESCRITO AL USAR EL COMPARADOR? I/O DIGITAL, NON-USED
	    ;RA3 = AN3 -> INPUT INV COMPARADOR A 1 Y 2, REFERENCIA COMUN
	    ;RA5 = AN4 -> INPUT CONVERTIDOR A/D -> CANAL
;*/
		BSF		ADCON1,6;	SELECCION DEL BIT DE CONVERSION 2 DEL CLOCK: FOSC/64
		BCF		ADCON1,7; 	JUSTIFICADO A LA IZQ, ENMASCARA BITS <1:0 LOS PASOS DEBERIAN SER MULTIPLOS DE CUATRO PARA QUE LOS AGARRE???
;CONVERTIDOR ANALOGICO
		MOVLW 0X02
		MOVWF CMCON
		BSF CMCON, 4;	

;SERIAL
	
		BCF TRISC,6;	    TX PIN COMO SALIDA
		BSF TRISC,7;	    RX PIN COMO INPUT
		MOVLW h'81';	    X=129
		MOVWF SPBRG;	    CONFIGURANDO EL BAUD RATE A 9600 BAUD/S CON EL CLOCK DE 20MHZ
		MOVLW h'26';	    TXEN=1, BRGH=1, TRMT=1, ESTE ES READ ONLY, PERO AJA, SIN PARIDAD
		MOVWF TXSTA;	    CONFIGURANDO TXSTA COMO ASINCRONO

		MOVLW h'C0'
		MOVWF INTCON; HABILITANDO GIE Y PEIE, esto tampoco hace nada
		BSF PIE1,RCIE
		BCF STATUS, RP1
		BCF STATUS, RP0;    CAMBIO A BANCO 0

		MOVLW h'90'
		MOVWF RCSTA;	    CONFIGURANDO EL RCSTA PARA ASINCRONO
		BCF PIR1, RCIF;	    LIMPIANDO LA BANDERA DE RECEPCION, no hace nada
		
		
								
		BCF		STATUS,RP0
		BCF		STATUS,RP1
;PWM
		MOVLW	D'155'
		MOVWF	PR2
		BCF		TRISC,2		;RC2
								;BANCO 0
;CISTERNA
		BSF		ADCON0,ADCS1;	CONVERSION DEL RELOJ
		BCF		ADCON0,ADCS0; 	FOSC/64
		BSF		ADCON0,CHS2;	SELECCION DEL CANAL ANALOGICO
		BCF		ADCON0,CHS1
		BCF		ADCON0,CHS0; 	CANAL AN4
		BSF		ADCON0,0; 	ADC ON
		
;PWM
		MOVLW   B'00111110' ;50%DUTYCYCLE
		MOVWF	CCPR1L
		BSF		CCP1CON,5 	; 1 
		BCF		CCP1CON,4	; 0
		BCF		T2CON,1 	;4 PRESCALER
		BSF		T2CON,0
		BSF		T2CON,2		; TMR2 ON
		

START:
		CALL Retardo_400ms
		BSF		ADCON0,2		; 	GO/!DONE -> 1
		CALL Retardo_400ms
ADC:
		BTFSC	ADCON0,2
		GOTO	ADC;			MIENTRAS CONVERTIMOS
		BCF		STATUS,Z
		BCF		STATUS,C
		MOVF	ADRESH,W;		NIVEL DEL TANQUE
		SUBLW   D'128';			TESTEAR CON LA MIT
		BTFSC 	STATUS,Z
		GOTO    MITAD;			2.5 VOLTIOS DE NIVEL
		BTFSS	STATUS,C
		GOTO	MLLENO;			NIVEL > 2.5 VOLTIOS
		GOTO    MVACIO;			NIVEL < 2.5 VOLTIOS


MITAD:							
		CALL 	ABRIRVALVULA
		;BTFSS  	;C10OU			 	;TESTEAMOS EL ESTADO DE LA VALVULA
		;GOTO	MITAD
		GOTO	START;  		


MLLENO:	
		BCF		STATUS,Z
		BCF		STATUS,C;		NO SE SI ESTAS BANDERAS TAMBIEN HAY QUE LIMPIARLAS PERO PORSIA, SI SI HAY QUE LIMPIARLAS CRACK!
		MOVF	ADRESH,W;		NIVEL DEL TANQUE
		SUBLW	D'205';			TESTEAR CON 4 VOLTIOS
		BTFSC 	STATUS,Z
		GOTO    CUATRO;			4 VOLTIOS DE NIVEL
		BTFSS	STATUS,C	
		GOTO	MAYOR4;			NIVEL > 4 VOLTIOS
		GOTO    NIVEL2;			NIVEL < 4 VOLTIOS

		
CUATRO:	
		CALL	ABRIRVALVULA    ;ACA SIEMPRE ESATAREMOS LLENANDO MIENTRAS HAYA AGUA A EXCEPCION DE QUE ESTEMOS FULLS
								;NO COMO EN EL TINACO QUE SI HAY QUE RESPETAR LA CONDICION DE LOS 4 VOLTIOS
		;BTFSS  					;TESTEAMOS ESTADO DE LA VALVULA
		;GOTO	CUATRO
		GOTO	START; 

		
MAYOR4:
		BCF		STATUS,Z
		BCF		STATUS,C;		NO SE SI ESTAS BANDERAS TAMBIEN HAY QUE LIMPIARLAS PERO PORSIA
		MOVF	ADRESH,W;		NIVEL DEL TANQUE
		SUBLW	D'255';			TESTEAR CON 5 VOLTIOS
		BTFSC 	STATUS,Z
		GOTO    LLENO;			5 VOLTIOS DE NIVEL
		BTFSS	STATUS,C
		GOTO	AGUAAA;			NIVEL > 5 VOLTIOS
		GOTO    NIVEL3;			NIVEL < 5 VOLTIOS
	

LLENO:
    	CALL 	CERRARVALVULA	;DE MADRUGADA Y SI ACASO PQ AJA
								;CASO MUY RARO DE ESTAR FULLS DE AGUA EN TODOS LADOS
		;BTFSC;                   ;COMPROBAMOS QUE ESTA CERRADA
       ; GOTO    LLENO
		GOTO 	START				


NIVEL3:
   		CALL	ABRIRVALVULA	; NIVEL 3
		;BTFSS  					;TESTEAMOS ESTADO DE LA VALVULA
		;GOTO	NIVEL3
		GOTO	START						


AGUAAA:
   		CALL	CERRARVALVULA	;DESPIERTA ESTO ES VENEZUELA
		;BTFSC					;ESTE CASO SOLO LO ESTARIAMOS MANEJANDO PARA EL SUPUESTO ERROR DE
		;GOTO	AGUAAA			;TENER AGUA DE MAS Y SIMPLEMENTE CERRAMOS LA VALVULA COMO EL LLENO
		GOTO 	START


NIVEL2:
   		CALL	ABRIRVALVULA	;NIVEL 2
		;BTFSS   				;TESTEAMOS ESTADO DE LA VALVULA
		;GOTO	NIVEL2					
		GOTO	START	


MVACIO:	
		BCF		STATUS,Z
		BCF		STATUS,C;	  	 NO SE SI ESTAS BANDERAS TAMBIEN HAY QUE LIMPIARLAS PERO PORSIA
		MOVF	ADRESH,W;      	NIVEL DEL TANQUE
		SUBLW	D'51';		   	TESTEAR CON 1 VOLTIO
		BTFSC 	STATUS,Z
		GOTO    BOMBAOFF;	   	1 VOLTIO DE NIVEL
		BTFSS	STATUS,C
		GOTO	NIVEL1;		   	NIVEL > 1 VOLTIO
		GOTO	SEQUEMO;       	NIVEL <1 VOLTIO


BOMBAOFF:
		CALL	APAGARBOMBA
		;AND MENSAJE LEER Y COM[ARAR						;NO VEO OTRA MANERA DE HACER ESTO DISTINTA A DESHABILITAR EL MODULO
								;Y POR ENDE NO TENGO NADA QUE TESTEAR PARA QUE SI HAYA ESTA APAGADA
								;NO LA SIGA REAPAGANDO HASTA QUE EL NIVEL DEL AGUA SUBA
		GOTO	START

NIVEL1:
    	CALL	ABRIRVALVULA	;NIVEL 1
		;BTFSS					;TESTEAMOS ESTADO DE LA VALVULA
		;GOTO	NIVEL1
		GOTO	START


SEQUEMO:
		CALL	APAGARBOMBA		; MISMO CASO DE CUANDO HAY MAS DE 5V DE AGUA
								; PREVENCION Y MISMA RESOLUCION POR POSIBLES ERRORES
		GOTO	START

ABRIRVALVULA					;-----------------ESTOY TOMANDO EN CUANTA QUE LA VALVULA ABIERTA ES 1 Y CERRADA 0-----------------------
		BCF STATUS, RP1	
		BSF STATUS, RP0						;-----------------IGUAL DE SER AL REVES SIMPLEMENTE HAY QUE INVERTIR LOS BTFSC Y BTFSS------------------
							;-----------------IGUAL DE SER AL REVES SIMPLEMENTE HAY QUE INVERTIR LOS BTFSC Y BTFSS------------------
								;-----------------PERO PARA QUE ENTIENDAS LA LOGICA IGUAL CON LA PRESION 1 HAY 0 NO HAY-----------------
		BTFSS  CMCON, C1OUT;TESTEO LA PRESION DEL AGUA CON C1OUT O EL QUE TENGA QUE SER
		CALL	MANUAL
		;BTFSS	PORTB,RB2				; TESTEO EL ESTADO DE LA VALVULA
		BSF	PORTB, RB2				;ABRIMOS LA VALVULA
		RETURN
CERRARVALVULA
					;TESTEAMOS ESTADO DE LA VALVULA
		BCF		PORTB, RB2				;CERRAMOS LA VALVULA
								;SOLO CERRAREMOS LA VALVULA ESTANDO LLENOS
								;O SI NOS LLAMA MANUAL	
		RETURN
APAGARBOMBA
		BCF		CCP1CON,3		; PWM MODE DISABLED
		BCF		CCP1CON,2
		BCF		CCP1CON,1
		BCF		CCP1CON,0						
		RETURN
ENCENDEBOMBA
								;SE SUPONE QUE ACA SOLO VENGO POR ORDEN DEL TINACO PERO DEBEMOS CHEQUEAR EL NIVEL PRIMERO
		BCF		STATUS,Z
		BCF		STATUS,C;	  	NO SE SI ESTAS BANDERAS TAMBIEN HAY QUE LIMPIARLAS PERO PORSIA
		MOVF	ADRESH,W;      	NIVEL DEL TANQUE
		SUBLW	D'51';		   	TESTEAR CON 1 VOLTIO
		BTFSC 	STATUS,Z
		CALL	APAGARBOMBA;	1 VOLTIO DE NIVEL
		BTFSS	STATUS,C
		GOTO	PLAY;		   	NIVEL > 1 VOLTIO
		CALL	APAGARBOMBA;    NIVEL <1 VOLTIO
		
		;ESTO NO ME GUSTA NADA PERO BERRO SIGO SIN SABER BIEN COMO SERA EL PROCESO SERIAL
								;PQ SOLO ESTOY HACIENDO ESTO TIPO QUE AL RECIBIR LA SENAL DE ENCENDERBOMBA
								;VENGO ACA Y COMPRUEBO QUE EL NIVEL ES MAYOR A 1 VOLTIO PARA ENCENDER Y SINO LA APAGO
								;ASI YA ESTE APAGADA O LE DIGO AL TINACO QUE NO LA PUEDO PRENDER PERO COMO NO SE SI ESO
								;SE PUEDE Y ES LO QUE HARIAMOS SI EL NIVEL ES MENOR O IGUAL A 1 VOLTIO LO PONGO ASI
								;FEO PERO YA ACA EN EL CODIGO A FALTA DE MODIFICARLO PUES, SE QUE NO ESTA BIEN PERO YA LO
								;ACOMODAREMOS ACOPLANDO LA COMUNICACION
MANUAL	
		CALL	CERRARVALVULA	;CAEMOS AQUI SE SUPONE QUE PQ NO HAY PRESION COMO YA SABEMOS
		BCF	STATUS, RP1	
		BSF	STATUS, RP0						
		BTFSS	CMCON, C1OUT				;TESTEAMOS LA PRESION
		GOTO	MANUAL			;SEGUN MI LOGICA FUNCIONA AL PELO ESTA MANERA SOLO FALTA INGENIARSE COMO
								;HACER QUE SIGA CUMPLIENDO CON LOS REQUERIMIENTOS DEL TINACO PERO ESO
		BCF STATUS, RP1	
		BCF STATUS, RP0							;SEGURO LO RESOLVEMOS AL ESTAR ACOPLANDO EL PWM Y LA RECEPCION SERIAL
		RETURN


Retardo_400ms 
    CALL    Retardo_20ms
    CALL    Retardo_20ms
    CALL    Retardo_20ms
    CALL    Retardo_20ms
    CALL    Retardo_20ms
    CALL    Retardo_20ms
    CALL    Retardo_20ms
    CALL    Retardo_20ms
    CALL    Retardo_20ms
    CALL    Retardo_20ms 
    CALL    Retardo_20ms
    CALL    Retardo_20ms
    CALL    Retardo_20ms
    CALL    Retardo_20ms
    CALL    Retardo_20ms
    CALL    Retardo_20ms
    CALL    Retardo_20ms
    CALL    Retardo_20ms
    CALL    Retardo_20ms
    CALL    Retardo_20ms 
    Return
 
; 5ms 
Retardo_20ms
    MOVLW   D'200'; 1cy -> k
    GOTO    Retardos_ms ; 2cy 
 
; 5ms 
Retardo_5ms
    MOVLW   D'50'; 1cy -> k
    GOTO    Retardos_ms ; 2cy
Retardos_ms  
    MOVWF   CUENTA_2; cy
Retardo_Milis
    MOVLW   D'180' ; kcy -> x
    MOVWF   CUENTA ;kcy
BUCLE_milis
    NOP
    DECFSZ  CUENTA,F; kcy(x-1) + 2cy
    GOTO    BUCLE   ; 2kcy(x-1)
    DECFSZ  CUENTA_2,F ;cy(k-1) + 2cy 
    GOTO    Retardo_Milis ;2cy(k-1)
    RETURN  ;2cy   
    
    
    
; 1ms = 1000us
Retardo_1ms
    NOP
    NOP
    NOP
    MOVLW   D'10'; 1cy -> k
    GOTO    Retardos ; 2cy

Retardo_200us
    MOVLW   D'3'; 1cy -> k
    GOTO    Retardos ; 2cy    
   
Retardo_300us
    MOVLW   D'3'; 1cy -> k
    GOTO    Retardos ; 2cy
    
;500us 
Retardo_500us
    MOVLW   D'5'; 1cy -> k
Retardos  
    MOVWF   CUENTA_2; cy
Retardo_Micros
    MOVLW   D'165' ; kcy -> x
    MOVWF   CUENTA ;kcy
BUCLE
    DECFSZ  CUENTA,F; kcy(x-1) + 2cy
    GOTO    BUCLE   ; 2kcy(x-1)
    DECFSZ  CUENTA_2,F ;cy(k-1) + 2cy 
    GOTO    Retardo_Micros ;2cy(k-1)
    RETURN  ;2cy   

    
    
;100us
Retardo_100us; 8CY + 3XCY
    MOVLW   D'164'
    NOP
    GOTO    Retardo_micros

;50us
Retardo_50us	    ;7cy + 3xcy  
    MOVLW   D'81'
    GOTO    Retardo_micros
    
;20us 
Retardo_20us;7CY + 3XCY	    
    MOVLW   D'31'
    GOTO    Retardo_micros

;10us 
Retardo_10us;8CY + 3XCY
    MOVLW   D'14'
    NOP
    GOTO    Retardo_micros  
    
;5us    
Retardo_5us;7CY + 3XCY
    MOVLW   D'6'
    GOTO    Retardo_micros
Retardo_micros
    MOVWF   CUENTA
Bucle
    DECFSZ  CUENTA,F
    GOTO    Bucle
    RETURN 
    
;1us
Retardo_1us
    NOP
    RETURN


END

;BUENO BRO OBVIO A FALTA DE AGREGARLE UN SENTIDO AL DESCUBRIMIENTO DE CADA NIVEL LO VEO BIEN
;SE ME OCURRE MANEJAR CALLS EN CADA NIVEL QUE DEN PASO A NOTIFICAR EL NIVEL
;DICHA NOTIFICACION GUIA LAS ACCIONES A TOMAR Y CHILL CON EL RETURN DEL CALL
;YA VOLVERIAMOS A NUESTRO BELLO GOTO START PARA SEGUIR VIENDO LOS NIVELES
;CREO QUE ASI SEGUIRIAMOS EL FLUJO DE QUE EL NIVEL DETERMINA LAS ACCIONES A TOMAR OBVIO CON
;CON TODAS SUS RESPECTIVAS PREGUNTAS Y OTROS CONDICIONANTES PERO NI IDEA JAJAJAJ
;
;		
;	
;UPDATE 01/08 - 1:27: BRO, SI ACTIVAMOS MODO MANUAL HAY QUE PONER EL A/D CON EL RELOJ INTERNO PORQUE EN SLEEP SE APAGA EL CRISTAL, ES DECIR EL ADCON0 DEBE ESTAR EN B '00000011' ES DECIR 0X03
;VER LA PАg 129 del manual y la tabla por si no me explique bien, creo que en esencia solo le cambia la velocidad al clock, que ahora es interno
;no lo modifique directamente, porque no quiero cambiarte nada sin saber
;SLEEP PAG 158
