processor 16f877a
; PIC16F877A Configuration Bit Settings
; Assembly source line config statements
#include "p16f877a.inc"

; CONFIG
; __config 0xFF7A
 __CONFIG _FOSC_HS & _WDTE_OFF & _PWRTE_OFF & _BOREN_ON & _LVP_OFF & _CPD_OFF & _WRT_OFF & _CP_OFF
org 0x00
GOTO MAIN
 MAIN:
	BCF STATUS,6
	BSF STATUS,5;    CAMBIO A BANCO 1
	
	BCF TRISC,6;	    TX PIN COMO SALIDA
	BSF TRISC,7;	    RX PIN COMO INPUT
	
	MOVLW b'00000000';	    SELECCIONANDO EL PUERTO D COMO SALIDA PARA EL 7 SEGMENTOS
	MOVWF TRISD
	
	MOVLW h'1F'
	MOVWF SPBRG;	    CONFIGURANDO EL BAUD RATE A 9600 BAUD/S CON EL CLOCK DE 20MHZ
	MOVLW h'20'
	MOVWF TXSTA;	    CONFIGURANDO TXSTA COMO ASINCRONO
	
	MOVLW h'C0'
	MOVWF INTCON; HABILITANDO GIE Y PEIE
	
	BCF STATUS, RP1
	BCF STATUS, RP0;    CAMBIO A BANCO 0
	
	MOVLW h'90'
	MOVWF RCSTA;	    CONFIGURANDO EL RCSTA PARA ASINCRONO
	BCF PIR1, RCIF;	    LIMPIANDO LA BANDERA DE RECEPCION
	
	;EMPEZANDO TRANSMISION
	MOVLW 'E'
	MOVWF TXREG
	CALL TRANSMIT
	
	MOVLW 'N'
	MOVWF TXREG
	CALL TRANSMIT
	
	MOVLW 'T'
	MOVWF TXREG
	CALL TRANSMIT
	
	MOVLW 'E'
	MOVWF TXREG
	CALL TRANSMIT
	
	MOVLW 'R'
	MOVWF TXREG
	CALL TRANSMIT
	
	MOVLW ' '
	MOVWF TXREG
	CALL TRANSMIT
	
	MOVLW 'N'
	MOVWF TXREG
	CALL TRANSMIT
	
	MOVLW 'O'
	MOVWF TXREG
	CALL TRANSMIT
	
	MOVLW ':'
	MOVWF TXREG
	CALL TRANSMIT

	MOVLW ' '
	MOVWF TXREG
	CALL TRANSMIT
	
	CALL RX_CHECK

RX_CHECK:
	BTFSC PIR1, RCIF;   VERIFICO QUE HE RECIBIIDO EL MENSAJE
	CALL RECEIVED
	GOTO RX_CHECK
	RETURN
RECEIVED:
	MOVF RCREG,0;	    LEO EL DATO Y MUEVO EL CONTENIDO DE RCREG A W
	MOVWF PORTD;	    SACO EL DATO EN PANTALLA
	BCF PIR1, RCIF;	    LIMPIO LA BANDERA DE RECEPCIсN PARA RECIBIR UN NUEVO DATO
	RETURN
TRANSMIT:
	BTFSS PIR1, TXIF;    VERIFICO QUE EL BUFFER ESTи VACIO PARA COMENZAR LA TRANSMISIсN
	GOTO TRANSMIT;	    
	BCF PIR1,TXIF;	    HAY QUE LIMPIAR LA BANDERA
	RETURN
END
	
	
	
	
	
	
	


